/dts-v1/;
/plugin/;

/ {
	fragment@0 {
		target = <&i2c5>;

		__overlay__ {
			status = "okay";
		};
	};

	fragment@1 {
		target = <&bq25703>;

		__overlay__ {
			status = "okay";
		};
	};

	fragment@2 {
		target = <&cw201x>;

		__overlay__ {
			status = "okay";
		};
	};
};
