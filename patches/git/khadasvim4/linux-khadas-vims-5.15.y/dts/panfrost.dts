/dts-v1/;
/plugin/;

/ {
	fragment@0 {
		target = <&gpu>;

		__overlay__ {
			compatible = "amlogic,meson-g12a-mali", "arm,mali-bifrost";
			interrupt-names = "gpu", "mmu", "job";
			dma-coherent;
		};
	};
};
