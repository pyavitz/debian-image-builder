/dts-v1/;
/plugin/;

/ {
	compatible = "radxa,zero", "amlogic,g12a";

	fragment@0 {
		target-path = "/";
		__overlay__ {
			aliases {
				rtc0 = &rtc;
			};
		};
	};

	fragment@1 {
		target = <&i2c3>;
		__overlay__ {
			#address-cells = <1>;
			#size-cells = <0>;

			rtc: rtc@68 {
				compatible = "dallas,ds1307";
				reg = <0x68>;
				wakeup-source;
			};
		};
	};

	__overrides__ {
		rtc = <0>,"+0";
		addr = <&rtc>, "reg:0";
	};
};
