/dts-v1/;
/plugin/;

/ {
	compatible = "sinovoip,bpi-m4-zero", "allwinner,sun50i-h618";

	fragment@0 {
		target-path = "/";
		__overlay__ {
			model = "BananaPi BPI-M4-Zero v2";
		};
	};

	/* SDIO WIFI */
	fragment@1 {
		target = <&mmc1>;
		__overlay__ {
			status = "okay";
		};
	};

	/* BLUETOOTH */
	fragment@2 {
		target = <&uart1>;
		__overlay__ {
			status = "okay";
		};
	};
};
