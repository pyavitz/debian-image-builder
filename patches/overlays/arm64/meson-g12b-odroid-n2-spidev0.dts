/dts-v1/;
/plugin/;

#include <dt-bindings/gpio/meson-g12a-gpio.h>
#include <dt-bindings/gpio/gpio.h>

/ {
	fragment@0 {
		target = <&spicc0>;

		__overlay__ {
			status = "okay";
			#address-cells = <1>;
			#size-cells = <0>;

			spidev: spidev@0 {
				status = "okay";
				compatible = "odroid,spi-dev";
				reg = <0>;
				spi-max-frequency = <100000000>;
			};
		};
	};
};
