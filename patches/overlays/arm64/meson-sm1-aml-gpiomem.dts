/dts-v1/;
/plugin/;

/ {
	/* This depends on the amlogic gpio memory device driver */
	fragment@0 {
		target-path = "/";
		__overlay__ {
			gpiomem {
				compatible = "amlogic, gpiomem";
				reg = <0x0 0xff634000 0x0 0x1000>,	/* GPIO banks */
					<0x0 0xff800000 0x0 0x1000>;	/* GPIO_AO bank */
				status = "okay";
			};
		};
	};
};
