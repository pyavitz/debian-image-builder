/dts-v1/;
/plugin/;

/ {
	fragment@0 {
		target = <&ehci0>;
		__overlay__ {
			status = "okay";
		};
	};

	fragment@1 {
		target = <&ohci0>;
		__overlay__ {
			status = "okay";
		};
	};

	fragment@2 {
		target = <&usbotg>;
		__overlay__ {
			dr_mode = "host";
		};
	};
};
