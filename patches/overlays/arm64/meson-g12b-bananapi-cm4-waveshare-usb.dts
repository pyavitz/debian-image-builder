/dts-v1/;
/plugin/;

/ {
	compatible = "bananapi,bpi-cm4io", "bananapi,bpi-cm4", "amlogic,a311d", "amlogic,g12b";

	fragment@0 {
		target = <&usb>;
		__overlay__ {
			dr_mode = "otg";
		};
	};

	fragment@1 {
		target = <&dwc2>;
		__overlay__ {
			dr_mode = "host";
		};
	};
};
