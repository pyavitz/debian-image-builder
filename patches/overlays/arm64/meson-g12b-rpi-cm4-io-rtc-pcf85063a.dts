/dts-v1/;
/plugin/;

/ {
	compatible = "bananapi,bpi-cm4io", "bananapi,bpi-cm4", "amlogic,a311d", "amlogic,g12b";

	fragment@0 {
		target-path = "/";
		__overlay__ {
			aliases {
				rtc0 = &rtc;
			};
		};
	};

	fragment@1 {
		target = <&i2c1>;
		__overlay__ {
			#address-cells = <1>;
			#size-cells = <0>;

			rtc: rtc@51 {
				compatible = "nxp,pcf85063a";
				reg = <0x51>;
				wakeup-source;
			};
		};
	};

	__overrides__ {
		rtc = <0>,"+0";
		addr = <&rtc>, "reg:0";
	};
};
