/dts-v1/;
/plugin/;

/ {
	fragment@0 {
		target = <&uart2>;
		__overlay__ {
			status = "okay";
			pinctrl-0 = <&uart2_ph_pins>, <&uart2_ph_rts_cts_pins>;
			pinctrl-names = "default";
			uart-has-rtscts;
		};
	};
};
