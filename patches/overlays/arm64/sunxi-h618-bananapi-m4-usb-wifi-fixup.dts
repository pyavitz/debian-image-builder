/dts-v1/;
/plugin/;

#include <dt-bindings/gpio/gpio.h>
#include <dt-bindings/interrupt-controller/arm-gic.h>

/ {
	compatible = "sinovoip,bpi-m4-zero", "allwinner,sun50i-h618";

	fragment@0 {
		target-path = "/";
		__overlay__ {
			usb_wifi: usb-wifi {
				gpios = <&pio 2 2 GPIO_ACTIVE_LOW>; /* PC2 */
				vmmc-supply = <&reg_dldo1>;
				vqmmc-supply = <&reg_aldo1>;
			};
		};
	};
};
