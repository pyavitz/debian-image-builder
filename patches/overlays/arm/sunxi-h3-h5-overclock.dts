/dts-v1/;
/plugin/;

/ {
	/* if the board is actually regulated this will not work */
	compatible = "allwinner,sun8i-h3", "allwinner,sun50i-h5";
	
	fragment@0 {
		target-path = "/opp-table-cpu";
		__overlay__ {
			opp-1368000000 {
				opp-hz = /bits/ 64 <1368000000>;
				opp-microvolt = <1300000 1300000 1300000>;
				clock-latency-ns = <244144>; /* 8 32k periods */
			};
		};
	};
};
