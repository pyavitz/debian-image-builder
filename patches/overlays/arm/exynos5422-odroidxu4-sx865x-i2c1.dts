/dts-v1/;
/plugin/;

#include <dt-bindings/gpio/gpio.h>

/ {
	fragment@0 {
		// hsi2c_5 alised with i2c1
		target = <&hsi2c_5>;

		__overlay__ {
			status = "okay";

			#address-cells = <1>;
			#size-cells = <0>;

			sx865x: sx865x@49 {
				status = "okay";
				compatible = "semtech,sx8650";
				reg = <0x49>;
				#clock-cells = <0>;

				/* H/W Pin control setup */
				gpio-pendown = <&gpx3 1 GPIO_ACTIVE_HIGH>;
				gpio-reset   = <&gpx2 5 GPIO_ACTIVE_LOW>;

				/* platform data setup */
				invert-x = <0>;
				invert-y = <1>;
				swap-xy = <1>;
			};
		};
	};
};
