## patches/uboot/v2022.10/spacemit/k1_defconfig
```kconfig
CONFIG_RISCV=y
CONFIG_SYS_TEXT_BASE=0x00200000
CONFIG_SYS_MALLOC_LEN=0x1000000
CONFIG_NR_DRAM_BANKS=2
CONFIG_ENV_SIZE=0x4000
CONFIG_ENV_OFFSET=0x60000
CONFIG_DM_GPIO=y
CONFIG_SPL_DM_SPI=y
CONFIG_DEFAULT_DEVICE_TREE="k1-x_spl"
CONFIG_SPL_TEXT_BASE=0xC0801000
CONFIG_SPL_MMC=y
CONFIG_SPL_DRIVERS_MISC=y
CONFIG_SPL_SYS_MALLOC_F_LEN=0x5000
CONFIG_SPL_SIZE_LIMIT=0x31000
CONFIG_SPL=y
CONFIG_SPL_SPI_FLASH_SUPPORT=y
CONFIG_SPL_SPI=y
CONFIG_SYS_LOAD_ADDR=0x200000
# CONFIG_AHCI is not set
CONFIG_TARGET_SPACEMIT_K1X=y
CONFIG_SPL_OPENSBI_LOAD_ADDR=0x0
CONFIG_K1_X_BOARD_ASIC=y
CONFIG_ARCH_RV64I=y
CONFIG_RISCV_SMODE=y
# CONFIG_SPL_SMP is not set
CONFIG_LOCALVERSION=" SpacemiT"
# CONFIG_LOCALVERSION_AUTO is not set
CONFIG_DISTRO_DEFAULTS=y
CONFIG_HAS_CUSTOM_SYS_INIT_SP_ADDR=y
CONFIG_CUSTOM_SYS_INIT_SP_ADDR=0x1000000
CONFIG_STACK_SIZE=0x100000
CONFIG_FIT=y
CONFIG_SPL_FIT_SIGNATURE=y
CONFIG_SPL_LOAD_FIT_ADDRESS=0x08000000
# CONFIG_BOOTSTD is not set
CONFIG_LEGACY_IMAGE_FORMAT=y
CONFIG_OF_BOARD_SETUP=y
CONFIG_QSPI_BOOT=y
CONFIG_SD_BOOT=y
CONFIG_SD_BOOT_QSPI=y
CONFIG_SPI_BOOT=y
CONFIG_BOOTCOMMAND="bootm 0x08000000"
CONFIG_LOGLEVEL=5
CONFIG_SPL_LOGLEVEL=1
# CONFIG_SYS_DEVICE_NULLDEV is not set
CONFIG_DISPLAY_CPUINFO=y
CONFIG_DISPLAY_BOARDINFO=y
CONFIG_MISC_INIT_R=y
# CONFIG_PCI_INIT_R is not set
CONFIG_SPL_MAX_SIZE=0x33000
CONFIG_SPL_PAD_TO=0x0
CONFIG_SPL_BSS_START_ADDR=0xC0837000
CONFIG_SPL_BSS_MAX_SIZE=0x2000
CONFIG_SPL_BOARD_INIT=y
# CONFIG_SPL_RAW_IMAGE_SUPPORT is not set
# CONFIG_SPL_SHARES_INIT_SP_ADDR is not set
CONFIG_SPL_STACK=0xC0840000
CONFIG_SYS_SPL_MALLOC=y
CONFIG_HAS_CUSTOM_SPL_MALLOC_START=y
CONFIG_CUSTOM_SYS_SPL_MALLOC_ADDR=0x4000000
CONFIG_SYS_SPL_MALLOC_SIZE=0x2000000
CONFIG_SYS_MMCSD_RAW_MODE_U_BOOT_USE_PARTITION=y
CONFIG_SPL_ENV_SUPPORT=y
CONFIG_SPL_I2C=y
CONFIG_SPL_MMC_WRITE=y
CONFIG_SPL_MTD_SUPPORT=y
CONFIG_SPL_DM_SPI_FLASH=y
CONFIG_SPL_DM_RESET=y
CONFIG_SPL_POWER=y
# CONFIG_SPL_RAM_SUPPORT is not set
# CONFIG_SPL_SPI_FLASH_TINY is not set
CONFIG_SPL_SPI_FLASH_MTD=y
CONFIG_SPL_MTD_LOAD=y
CONFIG_SYS_LOAD_IMAGE_PARTITION_NAME="opensbi"
CONFIG_SYS_LOAD_IMAGE_SEC_PARTITION=y
CONFIG_SYS_LOAD_IMAGE_SEC_PARTITION_NAME="uboot"
CONFIG_SPL_USB_GADGET=y
CONFIG_SPL_FASTBOOT_LOAD=y
CONFIG_SPL_USB_SDP_SUPPORT=y
CONFIG_SPL_OPENSBI_SCRATCH_OPTIONS=0x0
CONFIG_FDT_SIMPLEFB=y
CONFIG_SYS_CBSIZE=256
CONFIG_SYS_PBSIZE=276
# CONFIG_CMD_CPU is not set
CONFIG_CMD_TLV_EEPROM=y
CONFIG_CMD_TLV_CUSTOM=y
CONFIG_SYS_BOOTM_LEN=0x10000000
CONFIG_CMD_NVEDIT_EFI=y
CONFIG_CMD_EEPROM=y
CONFIG_CMD_MD5SUM=y
CONFIG_CMD_ZIP=y
CONFIG_CMD_CLK=y
CONFIG_CMD_GPIO=y
CONFIG_CMD_GPIO_READ=y
CONFIG_CMD_GPT=y
CONFIG_CMD_GPT_RENAME=y
CONFIG_CMD_I2C=y
CONFIG_CMD_MMC=y
CONFIG_CMD_BKOPS_ENABLE=y
CONFIG_CMD_MTD=y
# CONFIG_CMD_SCSI is not set
CONFIG_CMD_USB=y
CONFIG_CMD_WDT=y
CONFIG_CMD_TFTPPUT=y
CONFIG_CMD_TFTPSRV=y
CONFIG_SYS_DISABLE_AUTOLOAD=y
CONFIG_CMD_BMP=y
CONFIG_CMD_TIME=y
CONFIG_CMD_GETTIME=y
CONFIG_CMD_KASLRSEED=y
CONFIG_CMD_TIMER=y
CONFIG_CMD_BTRFS=y
CONFIG_CMD_EXT4_WRITE=y
CONFIG_CMD_SQUASHFS=y
CONFIG_CMD_FS_UUID=y
CONFIG_CMD_JFFS2=y
CONFIG_JFFS2_MTDPARTS=y
CONFIG_JFFS2_PART_OFFSET=0x700000
CONFIG_JFFS2_PART_SIZE=0x100000
CONFIG_CMD_MTDPARTS=y
CONFIG_CMD_MTDPARTS_SPREAD=y
CONFIG_CMD_MTDPARTS_SHOW_NET_SIZES=y
CONFIG_MTDIDS_DEFAULT="nor0=d420c000.spi-0"
CONFIG_MTDPARTS_DEFAULT="d420c000.spi-0:64K@0(bootinfo),64K@64K(private),256K@128K(fsbl),64K@384K(env),192K@448K(opensbi),-@640K(uboot)"
CONFIG_CMD_UBI=y
CONFIG_SPACEMIT_FLASH=y
CONFIG_SPL_FASTBOOT=y
CONFIG_ENABLE_SET_NUM_PART_SEARCH=y
CONFIG_PARTITION_TYPE_GUID=y
CONFIG_MULTI_DTB_FIT=y
CONFIG_ENV_OVERWRITE=y
CONFIG_ENV_IS_NOWHERE=y
CONFIG_ENV_IS_IN_MMC=y
CONFIG_ENV_IS_IN_NFS=y
CONFIG_ENV_IS_IN_SPI_FLASH=y
CONFIG_SYS_MMC_ENV_DEV=1
# CONFIG_SPL_ENV_IS_NOWHERE is not set
CONFIG_ARP_TIMEOUT=200
CONFIG_NET_RETRY_COUNT=50
CONFIG_PROT_UDP=y
CONFIG_NET_RANDOM_ETHADDR=y
CONFIG_IP_DEFRAG=y
CONFIG_NET_MAXDEFRAG=65535
CONFIG_TFTP_BLOCKSIZE=32768
CONFIG_KEEP_SERVERADDR=y
CONFIG_BOOTP_SERVERIP=y
CONFIG_REGMAP=y
CONFIG_DEVRES=y
# CONFIG_SCSI_AHCI is not set
CONFIG_BUTTON=y
CONFIG_BUTTON_GPIO=y
CONFIG_SPL_CLK=y
CONFIG_SPL_CLK_CCF=y
CONFIG_SPACEMIT_K1X_CCU=y
CONFIG_DYNAMIC_DDR_CLK_FREQ=y
CONFIG_DMA=y
CONFIG_DMA_CHANNELS=y
CONFIG_USB_FUNCTION_FASTBOOT=y
CONFIG_FASTBOOT_BUF_ADDR=0x08000000
CONFIG_FASTBOOT_BUF_SIZE=0x10000000
CONFIG_FASTBOOT_FLASH=y
CONFIG_FASTBOOT_MULTI_FLASH_OPTION=y
CONFIG_FASTBOOT_FLASH_MMC_DEV=2
CONFIG_FASTBOOT_MMC_BOOT_SUPPORT=y
CONFIG_FASTBOOT_MMC_BOOT1_NAME="fsbl"
CONFIG_FASTBOOT_MMC_BOOT2_NAME="fsbl_1"
CONFIG_FASTBOOT_CMD_OEM_READ=y
CONFIG_FASTBOOT_SUPPORT_BLOCK_DEV=y
CONFIG_FASTBOOT_SUPPORT_SECOND_BLOCK_DEV=y
CONFIG_FASTBOOT_CMD_OEM_CONFIG_ACCESS=y
CONFIG_FASTBOOT_CMD_OEM_ERASE=y
CONFIG_FASTBOOT_CMD_OEM_ENV_ACCESS=y
CONFIG_SPL_FASTBOOT_CMD_OEM_ENV_ACCESS=y
CONFIG_K1X_GPIO=y
CONFIG_DM_I2C=y
# CONFIG_SPL_DM_I2C is not set
CONFIG_SPL_SYS_I2C_LEGACY=y
CONFIG_SYS_I2C_SPACEMIT=y
CONFIG_SPL_SYS_I2C_SPACEMIT=y
CONFIG_I2C_MUX=y
# CONFIG_INPUT is not set
CONFIG_MISC=y
CONFIG_I2C_EEPROM=y
CONFIG_SPACEMIT_K1X_EFUSE=y
CONFIG_SPL_SPACEMIT_K1X_EFUSE=y
CONFIG_SPACEMIT_SHUTDOWN_CHARGE=y
CONFIG_MMC=y
CONFIG_SUPPORT_EMMC_BOOT=y
CONFIG_MMC_IO_VOLTAGE=y
CONFIG_MMC_UHS_SUPPORT=y
CONFIG_MMC_HS400_ES_SUPPORT=y
CONFIG_SPL_MMC_HS400_ES_SUPPORT=y
CONFIG_MMC_HS400_SUPPORT=y
CONFIG_SPL_MMC_HS400_SUPPORT=y
# CONFIG_MMC_VERBOSE is not set
CONFIG_MMC_SDHCI=y
CONFIG_MMC_SDHCI_ADMA=y
CONFIG_SPL_MMC_SDHCI_ADMA=y
CONFIG_MMC_SDHCI_K1X=y
CONFIG_DM_MTD=y
# CONFIG_MTD_NOR_FLASH is not set
CONFIG_MTD_SPI_NAND=y
CONFIG_SPI_FLASH_GIGADEVICE=y
CONFIG_SPI_FLASH_WINBOND=y
CONFIG_SPI_FLASH_FM=y
CONFIG_SPINOR_BLOCK_SUPPORT=y
CONFIG_SPI_FLASH_MTD=y
CONFIG_PHY_REALTEK=y
CONFIG_SPACEMIT_K1X_EMAC=y
CONFIG_NVME_PCI=y
CONFIG_PCIE_DW_K1X=y
CONFIG_PHY_SPACEMIT_K1X_COMBPHY=y
CONFIG_PINCTRL=y
CONFIG_PINCTRL_SINGLE=y
CONFIG_POWER_DOMAIN=y
CONFIG_K1X_POWER_DOMAIN=y
CONFIG_DM_PMIC=y
# CONFIG_SPL_DM_PMIC is not set
CONFIG_PMIC_SPM8XX=y
CONFIG_DM_REGULATOR=y
CONFIG_DM_REGULATOR_SPM8XX=y
CONFIG_DM_REGULATOR_SPACEMIT_HUB=y
CONFIG_DM_BATTERY=y
CONFIG_CW2015_BATTERY=y
CONFIG_DM_CHARGER=y
CONFIG_SGM41515_CHARGER=y
CONFIG_SPL_SPACEMIT_POWER=y
CONFIG_DM_PWM=y
CONFIG_PWM_PXA=y
CONFIG_RESET_SPACEMIT_K1X=y
CONFIG_DM_RNG=y
# CONFIG_SCSI is not set
# CONFIG_DM_SCSI is not set
CONFIG_SYS_NS16550_IER=0x40
# CONFIG_HTIF_CONSOLE is not set
# CONFIG_SIFIVE_SERIAL is not set
CONFIG_SPI=y
CONFIG_K1X_QSPI=y
CONFIG_K1X_SPI=y
# CONFIG_SYSRESET_SBI is not set
# CONFIG_SYSRESET_SYSCON is not set
CONFIG_SYSRESET_WATCHDOG=y
CONFIG_TIMER_EARLY=y
CONFIG_USB=y
CONFIG_USB_XHCI_HCD=y
CONFIG_USB_XHCI_DWC3=y
CONFIG_USB_EHCI_HCD=y
CONFIG_USB_EHCI_K1X=y
CONFIG_USB_DWC3=y
# CONFIG_USB_DWC3_GADGET is not set
CONFIG_USB_DWC3_GENERIC=y
CONFIG_TYPEC_HUSB239=y
CONFIG_USB_KEYBOARD=y
CONFIG_SYS_USB_EVENT_POLL_COMPATIBLE=y
CONFIG_USB_GADGET=y
CONFIG_USB_GADGET_VENDOR_NUM=0x361C
CONFIG_USB_GADGET_PRODUCT_NUM=0x1001
CONFIG_USB2_K1X_CI=y
# CONFIG_USB_SET_SERIAL_NUMBER is not set
CONFIG_DM_VIDEO=y
CONFIG_VIDEO_PCI_DEFAULT_FB_SIZE=0x1000000
CONFIG_VIDEO_COPY=y
CONFIG_SYS_WHITE_ON_BLACK=y
CONFIG_DISPLAY=y
CONFIG_SPLASH_SCREEN=y
CONFIG_SPLASH_SCREEN_ALIGN=y
CONFIG_SPLASH_SOURCE=y
CONFIG_VIDEO_BMP_RLE8=y
CONFIG_BMP_16BPP=y
CONFIG_BMP_24BPP=y
CONFIG_BMP_32BPP=y
CONFIG_VIDEO_SPACEMIT=y
CONFIG_DISPLAY_SPACEMIT_HDMI=y
CONFIG_DISPLAY_SPACEMIT_MIPI=y
CONFIG_DISPLAY_SPACEMIT_EDP=y
CONFIG_DISPLAY_SPACEMIT_DPI=y
CONFIG_WDT_SPACEMIT=y
CONFIG_WDT_PMIC_SPACEMIT=y
CONFIG_JFFS2_NOR=y
CONFIG_JFFS2_USE_MTD_READ=y
CONFIG_UBIFS_SILENCE_MSG=y
CONFIG_IMAGE_SPARSE_TRANSFER_BLK_NUM=0x3000
CONFIG_PRINT_TIMESTAMP=y
# CONFIG_SPL_USE_TINY_PRINTF is not set
# CONFIG_RSA is not set
# CONFIG_SPL_SHA1 is not set
# CONFIG_SPL_SHA256 is not set
# CONFIG_HEXDUMP is not set
CONFIG_OF_LIBFDT_OVERLAY=y
```

## patches/wireless/vs6621s/vs6621s/Kconfig
```kconfig
config VS6621S
    tristate "SKW wifi module VS6621S"
    help
      This driver supports the VS6621S WiFi module.
      To compile this driver as a module, choose M here: the module will be
      called vs6621s.

source "drivers/net/wireless/vs6621s/seekwaveplatform_lite/Kconfig"
source "drivers/net/wireless/vs6621s/swt6621s_wifi/Kconfig"
source "drivers/net/wireless/vs6621s/swtbt4l/Kconfig"
```

## patches/wireless/vs6621s/vs6621s/seekwaveplatform_lite/Kconfig
```kconfig
menuconfig SEEKWAVE_BSP_DRIVERS
        bool "SeekWave Platform Drivers For SeekWave Chip"
        default y
        help
        This is support seekwave chip for incard board
        if you want to buildin bsp driver
        please say "y" 
        Thanks.

config SEEKWAVE_PLD_RELEASE
    bool "seekwave Platfrom support chip recoverymode"
    depends on SEEKWAVE_BSP_DRIVERS
    default n

config SKW_NO_CONFIG
    bool "skw no config dts"
    depends on SEEKWAVE_BSP_DRIVERS
    default n

#seekwave`s wifi bluetooth device driver etc
if  SEEKWAVE_BSP_DRIVERS
source "drivers/net/wireless/vs6621s/seekwaveplatform_lite/usb/Kconfig"
source "drivers/net/wireless/vs6621s/seekwaveplatform_lite/sdio/Kconfig"
source "drivers/net/wireless/vs6621s/seekwaveplatform_lite/skwutil/Kconfig"
endif
```

## patches/wireless/vs6621s/vs6621s/seekwaveplatform_lite/sdio/Kconfig
```kconfig
config SKW_SDIOHAL
	tristate "Seekwave Platform  SDIO Driver Support"
	depends on SEEKWAVE_BSP_DRIVERS 
	default m
	help
	  Enable this module for seekwave
	  chip sdio interface bus Support.
	  Please insmod this module before any other
	  seekwave subsystem. Thanks.
```

## patches/wireless/vs6621s/vs6621s/swt6621s_wifi/Kconfig
```kconfig
config WLAN_VENDOR_SWT6621S
	tristate "SWT6621S chipset support"
	depends on CFG80211
	select CFG80211_WEXT_EXPORT if CFG80211=y
	default m
	help
	This module adds support for SeekWave 802.11ax wireless adapter chipset.

	If you have a wireless card belonging to this class, say Y.

	Note that the answer to this question doesn't directly affect the
	kernel: saying N will just cause the configurator to skip all the
	questions about these cards. If you say Y, you will be asked for
	your specific card in the following questions.

if WLAN_VENDOR_SWT6621S
config SWT6621S_LEGACY_P2P
	bool "SWT6621S Legacy P2P"
	default n
	help
	Say Y here to create interface p2p0 default

config SWT6621S_REPEATER_MODE
        bool "SWT6621S Repeater Mode"
        default n
        help
        Say Y here to support repeater mode

config SWT6621S_EXTERNAL_REGDB
	bool "Use External Regdomain Database"
	default n
	help
	Say Y here disable regdomain database in driver

config SWT6621S_TDLS
	bool "SWT6621S TDLS"
	default n
	help
	Say Y here to enable TDLS

config SWT6621S_DFS_MASTER
	bool "SWT6621S DFS Master"
	depends on SWT6621S_EXTERNAL_REGDB
	default n
	help
	Say Y here to support DFS master

config SWT6621S_OFFCHAN_TX
	bool "Seekwave OFFCHAN TX"
	default n
	help
	Say Y here to support off-channel TX

config SWT6621S_6GHZ
	bool "Seekwave 6GHz"
	default n
	help
	Say Y here to support 6GHz

config SWT6621S_USB3_WORKAROUND
	bool "SWT6621S USB 3.0 workaround"
	default n
	help
	Say Y here to enable workaround for USB 3.0

config SWT6621S_RX_REORDER_TIMEOUT
	int "SWT6621S reorder timeout (50-500)"
	range 50 500
	default 100

config SWT6621S_SKB_RECYCLE
	bool "SWT6621S skb recycle"
	default n
	help
	Say Y here to support skb recycle

config SWT6621S_DEFAULT_COUNTRY
	string "SWT6621S Default Country Code"
	default ""
	help
	Set Default Country Code

config SWT6621S_CHIP_ID
	string "SWT6621S Chip ID"
	default ""
	help
	Set Chip ID

config SWT6621S_PROJECT_NAME
	string "SWT6621S Default Project Name"
	default "SEEKWAVE"
	help
	Set Default Project Name

config SWT6621S_WDS
	bool "SWT6621S Wds Support"
	default n
	help
	Say Y here to support WDS

config SWT6621S_PRESUSPEND_SUPPORT
	bool "SWT6621S Presuspend Support"
	default n
	help
	Say Y here to support presuspend

choice
	prompt "SWT6621S Log Level"
	default SWT6621S_LOG_DEBUG
	help
	SEEKWAVE Log Level

config SWT6621S_LOG_ERROR
	bool "ERROR"
	help
	This feature set Error log level

config SWT6621S_LOG_WARN
	bool "WARN"
	help
	This feature set Warnning log level

config SWT6621S_LOG_INFO
	bool "INFO"
	help
	This feature set INFO log level

config SWT6621S_LOG_DEBUG
	bool "DEBUG"
	help
	This feature set DEBUG log level

config SWT6621S_LOG_DETAIL
	bool "DETAIL"
	help
	This feature set DETAIL log level

endchoice

endif
```

## patches/wireless/vs6621s/vs6621s/swtbt4l/Kconfig
```kconfig
config SKW_BT
        tristate "Seekwave BT driver"
        depends on (SEEKWAVE_BSP_DRIVERS || SEEKWAVE_BSP_DRIVERS_V20) && MMC
        default m
        help
          The driver for seekwave Bluetooth chipsets .

          Say Y here to compile support for Seekwave BT driver
          into the kernel or say M to compile it as module.
```
